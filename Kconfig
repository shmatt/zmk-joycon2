## dts/bindings/behaviors/zmk,behavior-joycon2-central-test.yaml
```yaml
description: |
  Joy-Con 2 project Stage 1 sub-stage 2 test behavior. When pressed, starts a
  one-shot BLE central scan and connects to the first connectable advertiser
  found, to test whether a third concurrent BLE central role survives
  alongside ZMK's existing host and split-half connections. Reports the
  result (and current LE connection counts by role) via the debug-print
  helper a couple of seconds after connecting, or after a 15s timeout if
  nothing was found.

compatible: "zmk,behavior-joycon2-central-test"

include: zero_param.yaml
```

## dts/bindings/behaviors/zmk,behavior-joycon2-connect.yaml
```yaml
description: |
  Joy-Con 2 project Stage 1 sub-stage 4 behavior. When pressed, scans for a
  real Joy-Con 2 (filtered by its BLE service UUID), connects, discovers its
  GATT characteristics, subscribes to input/response notifications, runs the
  IMU-enable + MAC-binding command handshake, then relays raw input
  notification payloads as hex via the debug-print helper.

compatible: "zmk,behavior-joycon2-connect"

include: zero_param.yaml
```

## dts/bindings/behaviors/zmk,behavior-joycon2-debug-print.yaml
```yaml
description: |
  Joy-Con 2 debug-print behavior. When pressed, types a canned debug message
  (selected by param1, indexing into a fixed message table) via ZMK's HID
  keyboard report path, one character at a time, into whatever field has
  focus on the host.

compatible: "zmk,behavior-joycon2-debug-print"

include: one_param.yaml
```
