/ {
    behaviors {
        joycon2_debug_print: joycon2_debug_print {
            compatible = "zmk,behavior-joycon2-debug-print";
            #binding-cells = <1>;
        };

        joycon2_connect: joycon2_connect {
            compatible = "zmk,behavior-joycon2-connect";
            #binding-cells = <0>;
        };
    };
};
